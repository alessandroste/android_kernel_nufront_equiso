## arch/arm/mach-tl7689/Kconfig
```kconfig
menu "Nufront TL7689"
	depends on ARCH_TL7689

config MACH_TL7689_PAD_TEST
	bool "Nufront TL7689 Pad Test Board"
	select ARM_GIC
	select PL330
	select HAVE_PATA_PLATFORM
	select NUSMART_PL330_DMA
	select ARCH_SPARSEMEM_ENABLE if CPU_V7 && \
		!TL7689_HIGH_PHYS_OFFSET && MMU
	select ZONE_DMA if SPARSEMEM
	help
	  Include support for the Nufront TL7689 Pad Test Board.

config MACH_TL7689_PAD_REF
	bool "Nufront TL7689 Pad Ref Board"
	select ARM_GIC
	select PL330
	select HAVE_PATA_PLATFORM
	select ARCH_SPARSEMEM_ENABLE if CPU_V7 && \
		!TL7689_HIGH_PHYS_OFFSET && MMU
	select ZONE_DMA if SPARSEMEM
	help
	  Include support for the Nufront TL7689 Pad Ref Board.

config MACH_TL7689_PHONE_TEST
	bool "Nufront TL7689 Phone Test Board"
	select ARM_GIC
	select HAVE_PATA_PLATFORM
	select ARCH_SPARSEMEM_ENABLE if CPU_V7 && \
		!TL7689_HIGH_PHYS_OFFSET && MMU
	select ZONE_DMA if SPARSEMEM
	help
	  Include support for the Nufront TL7689 Phone Test Board.

config MACH_TL7689_PHONE_REF
	bool "Nufront TL7689 Phone Ref Board"
	select ARM_GIC
	select HAVE_PATA_PLATFORM
	select ARCH_SPARSEMEM_ENABLE if CPU_V7 && \
		!TL7689_HIGH_PHYS_OFFSET && MMU
	select ZONE_DMA if SPARSEMEM
	help
	  Include support for the Nufront TL7689 Phone Ref Board.

config TL7689_HIGH_PHYS_OFFSET
	bool "High physical base address for the TL7689 platform"
	depends on MMU 
	default y
	help
	  TL7689 board has the RAM available at 0x80000000, 
	  2046MB of which being mirrored at 0x80000000. 

config NUSMART_PL330_DMA
	bool
	select PL330
	help
	  NUSMART DMA API Driver for PL330 DMAC.

choice
	prompt "TL7689 chip class"
	depends on ARCH_TL7689
        default CHIP_NORMAL_NU7

config CHIP_NORMAL_NU7
	bool "Nu7 Normal"
	select CLASS_NORMAL_NU7
	help
	  Select chip class as normal.

config CHIP_HIGH_NU7
	bool "Nu7 High"
	select CLASS_HIGH_NU7
	help
	  Select chip class as high.

config TL7689_EFUSE_SUPPORT
        bool "tl7689 efuse support"
        depends on ARCH_TL7689
        help
          TL7689 EFUSE Support

endchoice

config CLASS_NORMAL_NU7
	bool
config CLASS_HIGH_NU7
	bool
config CLASS_ULTRA_NU7
	bool

config NUSMART_CTS_BUG2509
	bool "0002509: junit.framework.AssertionFailedError"
	depends on RICOH583_AC_DETECT 
	default y
	help
	 The testcase use posix timer which ID is CLOCK_THREAD_CPUTIME_ID 
	 to calc interval, and add log trace , we can fixed this bug;	
endmenu
```

## drivers/usb/gadget/dwc/Kconfig
```kconfig
config USB_GADGET_DESIGN_WARE
	boolean "DESIGN WARE usb device controller"
	depends on USB && EXPERIMENTAL
	select USB_OTG
	select USB_GADGET_DUALSPEED
	help
	  This is a DESIGN WARE usb device controller

config USB_DESIGN_WARE
	tristate
	depends on USB_GADGET_DESIGN_WARE   
	default USB_GADGET
	select USB_GADGET_SELECTED
```

## drivers/video/display/tve/Kconfig
```kconfig
#
# TV Encoder drivers configuration
#

menuconfig NUSMART_TVENCODER
	bool "Second display Encoder support"
    help
       Support Nusmart TV Encoder if you say y here.

source "drivers/video/display/tve/lcd/Kconfig"
source "drivers/video/display/tve/ch7026/Kconfig"
source "drivers/video/display/tve/cs8556/Kconfig"
```

## drivers/video/display/tve/ch7026/Kconfig
```kconfig
#
# TV Encoder CH7025/7026 drivers configuration
#

config CH7025_7026_TVOUT
	bool "CH7026 TV Encoder Support"
	depends on NUSMART_TVENCODER
	help
		Support Chrontel CH7026 TV Encoder.

config CH7026_TVOUT_VGA
	bool "Support VGA Output"
	depends on CH7025_7026_TVOUT
			
config CH7026_TVOUT_CVBS
	bool "Support CVBS Output"
	depends on CH7025_7026_TVOUT
```

## drivers/video/display/tve/cs8556/Kconfig
```kconfig
#
# TV Encoder CS8556 drivers configuration
#

config CS8556_TVOUT
	bool "CS8556 TV Encoder Support"
	depends on NUSMART_TVENCODER
	help
		Support Chrontel CS8556 TV Encoder.

config CS8556_TVOUT_VGA
	bool "Support CS8556 VGA Output"
	depends on CS8556_TVOUT
			
config CS8556_TVOUT_CVBS
	bool "Support CS8556 CVBS Output"
	depends on CS8556_TVOUT
```

## drivers/video/display/tve/lcd/Kconfig
```kconfig
#
# TV Encoder CH7025/7026 drivers configuration
#

config NS115_STICK_LCD_OUT
	bool "NS115 stick lcd out"
	depends on NUSMART_TVENCODER
	help
		Support HDMI STICK lcd output.
```

## sound/soc/nusmart/Kconfig
```kconfig
config SND_NUSMART_SOC
	tristate "SoC Audio for the Nufront ltd. ns2816&ns115 chips"
	depends on ARCH_REALVIEW_PBX && SND_SOC
	select SND_ARM

config SND_NUSMART_SOC_NOCODEC
    tristate "SoC Audio support for nusmart with no codec"
    depends on ARCH_NS115
    select SND_ARM
    help
      Say Y if you want to add support for SoC audio on Nusmart with no codec
      models.

config SND_NUSMART_SOC_MACH
	tristate "SoC Audio support for nusmart"
	depends on ARCH_NS115
	select SND_ARM
	help
	  Say Y if you want to add support for SoC audio on Nusmart
	  models.
choice
	prompt "Select CPU DAI"
	depends on SND_NUSMART_SOC_MACH
	default SND_NUSMART_SOC_EVA_I2S

config SND_NUSMART_SOC_I2S
	tristate "Use Synopsys I2S as CPU DAI"
	depends on SND_NUSMART_SOC_MACH
	help
	  Only applies on Nusmart2816-1

config SND_NUSMART_SOC_EVA_I2S
	tristate "Use Evatronics I2S as CPU DAI"
	depends on SND_NUSMART_SOC_MACH
	help
	  Only applies on Nusmart2816-2

endchoice

choice
	prompt "Select CODEC DAI"
	depends on SND_NUSMART_SOC_MACH
	default SND_SOC_ALC5631

config SND_SOC_ALC5616
	tristate "Use RT5616 as CODEC DAI"
	depends on SND_NUSMART_SOC_MACH
	default n

config SND_SOC_ALC5631
	tristate "Use RT5631 as CODEC DAI"
	depends on SND_NUSMART_SOC_MACH

config SND_SOC_ES8388
	tristate "Use ES8388 as CODEC DAI"
	depends on SND_NUSMART_SOC_MACH

endchoice
```
